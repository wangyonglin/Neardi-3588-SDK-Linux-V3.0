## buildroot/package/loongify/Config.in
```kconfig
menuconfig BR2_PACKAGE_LOONGIFY
	bool "Loongify QT apps"

	if BR2_PACKAGE_LOONGIFY
		source "package/loongify/apps/Config.in"
	endif
```

## buildroot/package/loongify/apps/loongify/Config.in
```kconfig
config BR2_PACKAGE_LOONGIFY_APPS_LOOGIFY
	bool "loongify"
	depends on BR2_PACKAGE_QT5
	help 
		loongify app by QT5
```
